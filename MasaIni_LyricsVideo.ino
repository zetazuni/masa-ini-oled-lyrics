/*
 * ╔═══════════════════════════════════════════════════════════╗
 * ║  ♫  LYRICS VIDEO — Heltec WiFi-LoRa 32 V4  ♫           ║
 * ║  "Masa Ini, Masa Nanti dan Masa Indah Lainnya"           ║
 * ║  by Nuca                                                  ║
 * ║                                                           ║
 * ║  Display  : SSD1315 OLED 128×64px (I2C)                 ║
 * ║  MCU      : ESP32-S3R2 (Xtensa LX7 dual-core)           ║
 * ╚═══════════════════════════════════════════════════════════╝
 *
 * ─── LIBRARY REQUIRED ───────────────────────────────────────
 *   • U8g2 by olikraus  →  Install via Arduino Library Manager
 *
 * ─── HOW TO USE ─────────────────────────────────────────────
 *   1. Run MasaIni_Stamper.py, press T when the song starts and
 *      SPACE at each lyric line. It writes lyrics_timestamps.h
 *      (lyrics, timings and SONG_DURATION_MS) next to this sketch.
 *   2. Flash this sketch (it #includes that file automatically).
 *   3. Press BOOT and start the song at the same moment.
 *      If everything is consistently early/late, adjust
 *      SYNC_OFFSET_MS below.
 *
 * ─── CONTROLS ───────────────────────────────────────────────
 *   BOOT button (GPIO 0) :
 *     Intro/Waiting → Start playback
 *     Playing       → Pause
 *     Paused        → Resume
 *     Done          → Replay
 *
 * ─── LAYOUT (128×64 pixels) ─────────────────────────────────
 *   y  0– 9  header   : bouncing notes, "Nuca", pause indicator
 *   y 10–54  lyrics   : 1 large line, or 2 medium lines
 *   y 57–63  progress : bar with elapsed mm:ss
 */

#include <Arduino.h>
#include <U8g2lib.h>
#include <Wire.h>

// ═══════════════════════════════════════════════
//  BOARD PIN DEFINITIONS (Heltec WiFi-LoRa 32 V4)
// ═══════════════════════════════════════════════
#define OLED_SDA    17
#define OLED_SCL    18
#define OLED_RST    21
#define VEXT_CTRL   36   // External 3.3V rail – pull LOW to enable
#define BTN_USR      0   // BOOT button (active LOW)

// ═══════════════════════════════════════════════
//  DISPLAY OBJECT
//  SSD1315 is SSD1306-compatible.
//  "F" = full-frame buffer (1 KB SRAM) — smooth animation.
// ═══════════════════════════════════════════════
U8G2_SSD1306_128X64_NONAME_F_HW_I2C
  disp(U8G2_R0, OLED_RST, OLED_SCL, OLED_SDA);

// ═══════════════════════════════════════════════
//  LYRICS  (struct Lyric, SONG_DURATION_MS, lyrics[], NUM_LYRICS)
//  Generated by MasaIni_Stamper.py — re-run it and re-flash.
// ═══════════════════════════════════════════════
#include "lyrics_timestamps.h"

// Fine-tune sync: positive = lyrics appear later, negative = earlier.
// Use this instead of re-stamping when the whole song is slightly off.
#define SYNC_OFFSET_MS  (0L)

// Time between pressing BOOT and the first lyric. Playback starts this many
// ms before the first lyric, so start the song at that position (see the
// progress-bar clock). 0 = play the whole song from 00:00.
#define PRE_ROLL_MS  (5000UL)

// ═══════════════════════════════════════════════
//  STATE MACHINE
// ═══════════════════════════════════════════════
enum AppState { INTRO, WAITING, PLAYING, PAUSED, DONE };
AppState appState = INTRO;

unsigned long songStartMs  = 0;   // millis() when playback began
unsigned long pausedAtMs   = 0;   // millis() when paused
int           curIdx       = -1;  // currently displayed lyric index

// Start (or restart) playback so the first lyric appears PRE_ROLL_MS from now.
void beginPlayback() {
  unsigned long first = (NUM_LYRICS > 0) ? lyrics[0].startMs : 0;
  unsigned long skip  = (first > PRE_ROLL_MS) ? first - PRE_ROLL_MS : 0;
  songStartMs = millis() - skip;
  curIdx      = -1;
  appState    = PLAYING;
}

// ═══════════════════════════════════════════════
//  MUSIC NOTE ANIMATION
//  Three small notes bounce independently in the header strip.
// ═══════════════════════════════════════════════
struct MNote { int x; float y; float vy; };
MNote mnotes[3] = {
  {  3, 0.5f, 0.15f},
  { 14, 2.0f, -0.12f},
  { 25, 1.0f, 0.10f},
};
unsigned long lastNoteMs = 0;

// Draw a compact 5×8 music note at pixel (px, py)
void drawMNote(int px, int py) {
  // Notehead – 4×3 filled ellipse approximation
  disp.drawBox(px,     py + 5, 4, 2);
  disp.drawHLine(px,   py + 4, 4);
  // Stem
  disp.drawVLine(px + 3, py,   5);
  // Beam / flag
  disp.drawHLine(px + 3, py,   4);
  disp.drawPixel(px + 6, py + 1);
}

void updateNotes() {
  if (millis() - lastNoteMs < 80) return;
  lastNoteMs = millis();
  for (auto& n : mnotes) {
    n.y += n.vy;
    if (n.y < 0.0f || n.y > 2.0f) n.vy = -n.vy;   // sprite is 7px tall: stay above the y=9 divider
  }
}

// ═══════════════════════════════════════════════
//  HELPER: centre a string horizontally
// ═══════════════════════════════════════════════
void drawCentred(const char* s, int y) {
  int w = disp.getStrWidth(s);
  disp.drawStr((128 - w) / 2, y, s);
}

// ═══════════════════════════════════════════════
//  PROGRESS BAR  (bottom strip, y = 58..62)
//  Plain frame + fill. The clock lives in the header: text drawn
//  inside a 5px bar clashed with the fill and looked garbled.
// ═══════════════════════════════════════════════
// Progress is measured from the first lyric to the end of the song, so the
// bar and clock sit at zero when the lyrics begin (not at the pre-roll skip).
unsigned long progressBase() { return (NUM_LYRICS > 0) ? lyrics[0].startMs : 0; }

void drawProgressBar(unsigned long elapsed) {
  const int bx = 1, by = 58, bw = 126, bh = 5;
  disp.drawFrame(bx, by, bw, bh);

  unsigned long base  = progressBase();
  unsigned long span  = SONG_DURATION_MS - base;
  unsigned long done  = (elapsed > base) ? elapsed - base : 0;
  long fill = (span > 0) ? ((long)done * (bw - 2)) / (long)span : 0;
  if (fill < 0) fill = 0;
  if (fill > bw - 2) fill = bw - 2;
  if (fill > 0) disp.drawBox(bx + 1, by + 1, (int)fill, bh - 2);
}

// "MM:SS/MM:SS" right-aligned in the header (from first lyric)
void drawClock(unsigned long elapsed) {
  unsigned long base = progressBase();
  unsigned long e = ((elapsed > base) ? elapsed - base : 0) / 1000;
  unsigned long t = (SONG_DURATION_MS - base) / 1000;
  char buf[16];
  snprintf(buf, sizeof(buf), "%02lu:%02lu/%02lu:%02lu", e / 60, e % 60, t / 60, t % 60);
  disp.setFont(u8g2_font_4x6_tf);
  disp.drawStr(126 - disp.getStrWidth(buf), 7, buf);
}

// ═══════════════════════════════════════════════
//  FIND LYRIC INDEX for a given elapsed time
// ═══════════════════════════════════════════════
int findLyricIdx(unsigned long elapsed) {
  for (int i = NUM_LYRICS - 1; i >= 0; i--) {
    if (elapsed >= lyrics[i].startMs && elapsed < lyrics[i].endMs)
      return i;
  }
  return -1;
}

// ═══════════════════════════════════════════════
//  SCREEN: INTRO
// ═══════════════════════════════════════════════
unsigned long introStart = 0;

void drawIntro() {
  if (!introStart) introStart = millis();
  unsigned long t = millis() - introStart;

  disp.clearBuffer();

  // Animated music notes (top-left cluster)
  updateNotes();
  for (auto& n : mnotes) drawMNote(n.x, (int)n.y);

  // Outer + inner border with corner decorations
  disp.drawFrame(0, 0, 128, 64);
  disp.drawPixel(2, 2); disp.drawPixel(125, 2);
  disp.drawPixel(2, 61); disp.drawPixel(125, 61);

  // Artist label — slides in from the right
  if (t > 400) {
    disp.setFont(u8g2_font_7x13B_tf);
    int ox = (t < 900) ? (int)((900 - t) / 20) : 0;
    int nw = disp.getStrWidth("Nuca");
    disp.drawStr((128 - nw) / 2 + ox, 18, "Nuca");
  }

  // Decorative divider
  if (t > 700) {
    disp.drawHLine(20, 21, 88);
    disp.drawPixel(19, 22); disp.drawPixel(108, 22);
  }

  // Song title — staggered line appearance
  disp.setFont(u8g2_font_5x7_tf);
  if (t > 900)  drawCentred("Masa Ini, Masa Nanti", 32);
  if (t > 1200) drawCentred("dan Masa Indah", 40);
  if (t > 1500) drawCentred("Lainnya", 48);

  // Blinking "press to start" hint
  if (t > 2000 && (t / 400) % 2 == 0) {
    disp.setFont(u8g2_font_4x6_tf);
    drawCentred("[ Tekan BOOT ]", 61);
  }

  disp.sendBuffer();

  if (t > 6000) { appState = WAITING; introStart = 0; }
}

// ═══════════════════════════════════════════════
//  SCREEN: WAITING (sedia untuk mula)
// ═══════════════════════════════════════════════
void drawWaiting() {
  disp.clearBuffer();
  disp.drawFrame(0, 0, 128, 64);
  updateNotes();
  for (auto& n : mnotes) drawMNote(n.x, (int)n.y);

  disp.setFont(u8g2_font_6x10_tf);
  drawCentred("Sedia untuk", 25);
  drawCentred("mula?", 37);

  if ((millis() / 450) % 2 == 0) {
    disp.setFont(u8g2_font_5x7_tf);
    drawCentred("Tekan BOOT  >>", 54);
  }
  disp.sendBuffer();
}

// ═══════════════════════════════════════════════
//  SCREEN: PLAYING / PAUSED
// ═══════════════════════════════════════════════
void drawLyricsScreen(int idx, unsigned long elapsed, bool paused) {
  disp.clearBuffer();

  // ── Header bar ─────────────────────────────
  disp.setFont(u8g2_font_4x6_tf);
  // Bouncing notes in header
  updateNotes();
  for (auto& n : mnotes) drawMNote(n.x, (int)n.y);
  // "Nuca" label
  disp.drawStr(36, 7, "Nuca");
  // Pause indicator
  if (paused && (millis() / 350) % 2 == 0) {
    disp.drawStr(62, 7, "II");
  }
  disp.drawHLine(0, 9, 128);

  // ── Progress bar ───────────────────────────
  drawClock(elapsed);
  drawProgressBar(elapsed);
  disp.drawHLine(0, 55, 128);

  // ── Lyric zone  (y: 10–54, 44 pixels tall) ─
  if (idx >= 0 && idx < NUM_LYRICS) {
    const Lyric& ly = lyrics[idx];
    bool two = strlen(ly.line2) > 0;

    if (!two) {
      // ── Single line: large centred ──────────
      disp.setFont(u8g2_font_7x13B_tf);
      int lw = disp.getStrWidth(ly.line1);

      // If too wide, fall back to smaller font
      if (lw > 124) {
        disp.setFont(u8g2_font_6x10_tf);
        lw = disp.getStrWidth(ly.line1);
      }
      int lx = (128 - lw) / 2;
      if (lx < 2) lx = 2;
      disp.drawStr(lx, 37, ly.line1);

      // Animated underline that grows left→right during lyric
      unsigned long lyDur = ly.endMs - ly.startMs;
      unsigned long lyEl  = elapsed - ly.startMs;
      if (lyDur > 0) {
        int ulw = (int)((float)lyEl / lyDur * lw);
        if (ulw > 0) disp.drawHLine(lx, 39, ulw);
      }

    } else {
      // ── Two lines: medium font ──────────────
      disp.setFont(u8g2_font_6x10_tf);
      drawCentred(ly.line1, 30);
      drawCentred(ly.line2, 43);
    }

    // Small ♪ dot-pulse in bottom-right of lyric zone
    unsigned long lyDur = ly.endMs - ly.startMs;
    unsigned long lyEl  = elapsed - ly.startMs;
    int dots = (lyDur > 0) ? (int)((float)lyEl / lyDur * 3) : 0;
    disp.setFont(u8g2_font_4x6_tf);
    for (int d = 0; d < min(dots, 3); d++)
      disp.drawStr(116 + d * 4, 53, ".");

  } else {
    // ── No active lyric — find how long until the next one ──
    int nextIdx = -1;
    for (int i = 0; i < NUM_LYRICS; i++) {
      if (elapsed < lyrics[i].startMs) { nextIdx = i; break; }
    }

    if (nextIdx >= 0) {
      unsigned long waitMs   = lyrics[nextIdx].startMs - elapsed;
      unsigned long waitSecs = waitMs / 1000;

      if (waitMs > 5000) {
        // Show countdown in seconds
        char buf[32];
        snprintf(buf, sizeof(buf), "lirik dalam %lus...", waitSecs);
        disp.setFont(u8g2_font_5x7_tf);
        drawCentred(buf, 33);

        // Mini fill bar showing how far through the wait we are
        int barW = 90;
        int barX = (128 - barW) / 2;
        int fill  = (int)((float)elapsed / lyrics[nextIdx].startMs * barW);
        fill = min(fill, barW);
        disp.drawFrame(barX, 40, barW, 4);
        if (fill > 0) disp.drawBox(barX, 40, fill, 4);

      } else {
        // Last 5 seconds — flash large countdown
        disp.setFont(u8g2_font_7x13B_tf);
        if ((millis() / 250) % 2 == 0) {
          char buf[12];
          snprintf(buf, sizeof(buf), "%lu", (waitMs + 999) / 1000);   // round up: 5,4,3,2,1
          drawCentred(buf, 38);
        }
      }
    } else {
      // Between lyric lines (brief gap mid-song)
      if ((millis() / 600) % 2 == 0) {
        disp.setFont(u8g2_font_6x10_tf);
        drawCentred("~ ~ ~", 36);
      }
    }
  }

  disp.sendBuffer();
}

// ═══════════════════════════════════════════════
//  SCREEN: DONE
// ═══════════════════════════════════════════════
void drawDone() {
  disp.clearBuffer();
  disp.drawFrame(0, 0, 128, 64);
  disp.drawFrame(2, 2, 124, 60);
  updateNotes();
  for (auto& n : mnotes) drawMNote(n.x, (int)n.y);

  disp.setFont(u8g2_font_6x10_tf);
  drawCentred("Terima kasih", 24);
  drawCentred("kerana mendengar", 36);

  // Dancing notes decoration
  disp.setFont(u8g2_font_5x7_tf);
  if ((millis() / 500) % 2 == 0) {
    disp.drawStr(28, 48, "* * * * *");
  } else {
    disp.drawStr(20, 48, "  * * * *  ");
  }

  if ((millis() / 600) % 2 == 0) {
    disp.setFont(u8g2_font_4x6_tf);
    drawCentred("[ BOOT untuk ulang ]", 61);
  }
  disp.sendBuffer();
}

// ═══════════════════════════════════════════════
//  BUTTON HANDLER
// ═══════════════════════════════════════════════
bool          btnPrev    = HIGH;
unsigned long lastBtnMs  = 0;

void checkButton() {
  bool btnNow = digitalRead(BTN_USR);
  if (btnPrev == HIGH && btnNow == LOW && millis() - lastBtnMs > 40) {   // non-blocking debounce
    lastBtnMs = millis();
    switch (appState) {
      case INTRO:
      case WAITING:
        beginPlayback();
        break;
      case PLAYING:
        pausedAtMs  = millis();
        appState    = PAUSED;
        break;
      case PAUSED:
        songStartMs += millis() - pausedAtMs;  // compensate paused time
        appState     = PLAYING;
        break;
      case DONE:
        beginPlayback();
        break;
    }
  }
  btnPrev = btnNow;
}

// ═══════════════════════════════════════════════
//  SETUP
// ═══════════════════════════════════════════════
void setup() {
  Serial.begin(115200);

  // Enable external 3.3V rail (powers OLED on Heltec boards)
  pinMode(VEXT_CTRL, OUTPUT);
  digitalWrite(VEXT_CTRL, LOW);
  delay(150);

  // Button
  pinMode(BTN_USR, INPUT_PULLUP);

  // Start I2C and display
  Wire.begin(OLED_SDA, OLED_SCL);
  disp.begin();
  disp.setContrast(255);
  disp.clearBuffer();
  disp.sendBuffer();

  Serial.println("Lyrics Video — ready.");
}

// ═══════════════════════════════════════════════
//  MAIN LOOP
// ═══════════════════════════════════════════════
void loop() {
  checkButton();

  switch (appState) {

    case INTRO:
      drawIntro();
      break;

    case WAITING:
      drawWaiting();
      break;

    case PLAYING: {
      long          rel     = (long)(millis() - songStartMs) - SYNC_OFFSET_MS;
      unsigned long elapsed = rel < 0 ? 0 : (unsigned long)rel;

      // Auto-advance lyrics
      int newIdx = findLyricIdx(elapsed);
      if (newIdx != curIdx) {
        curIdx = newIdx;
      }

      drawLyricsScreen(curIdx, elapsed, false);

      if (elapsed >= SONG_DURATION_MS) appState = DONE;
      break;
    }

    case PAUSED:
      // Show the last frame frozen (elapsed stays at pausedAtMs)
      {
        long rel = (long)(pausedAtMs - songStartMs) - SYNC_OFFSET_MS;
        drawLyricsScreen(curIdx, rel < 0 ? 0 : (unsigned long)rel, true);
      }
      break;

    case DONE:
      drawDone();
      break;
  }
}

/*
 * ─── LYRIC TIMING ────────────────────────────────────────────
 * Lyrics live in MasaIni_Stamper.py (LYRICS list). Re-run it to
 * regenerate lyrics_timestamps.h; long lines are auto-split into
 * two balanced rows. Use SYNC_OFFSET_MS for global sync tweaks.
 *
 * ─── FONT CHEAT-SHEET ────────────────────────────────────────
 *  u8g2_font_7x13B_tf  → big bold  (~18 chars/line) ← default lyric
 *  u8g2_font_6x10_tf   → medium    (~21 chars/line) ← 2-line mode
 *  u8g2_font_5x7_tf    → small     (~25 chars/line) ← titles
 *  u8g2_font_4x6_tf    → tiny      (~32 chars/line) ← header/hints
 *
 * ─── CUSTOMISATION ───────────────────────────────────────────
 *  • CONTRAST    : Change disp.setContrast(255)  [0–255]
 *  • NOTE SPEED  : Change the < 80 threshold in updateNotes()
 *  • SYNC        : SYNC_OFFSET_MS (ms, + = lyrics later)
 * ─────────────────────────────────────────────────────────────
 */
